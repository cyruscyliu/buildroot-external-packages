## Config.in
```kconfig
source "$BR2_EXTERNAL_EXTERNAL_PACKAGES_PATH/package/kernel_module/Config.in"
source "$BR2_EXTERNAL_EXTERNAL_PACKAGES_PATH/package/userspace_program/Config.in"
```

## package/userspace_program/Config.in
```kconfig
config BR2_PACKAGE_USERSPACE_PROGRAM
	bool "userspace_program"
	depends on BR2_LINUX_KERNEL
	help
	  Linux Userspace Program Cheat.
```

## userspace_program/Config.in
```kconfig
config BR2_PACKAGE_USER_SPACE_PROGRAM
	bool "user_space_program"
	depends on BR2_LINUX_KERNEL
	help
	  Linux User Space Program Cheat.
```
